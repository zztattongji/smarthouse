## boards_bearpi_h3863/application/samples/peripheral/smarthouse_actuator/Kconfig
```kconfig
# Smarthouse Board 3 — Actuator

config SMARTHOUSE_ACTUATOR_PWM_CH_LED
    int "LED PWM Channel"
    default 0
config SMARTHOUSE_ACTUATOR_PWM_CH_FAN
    int "Fan PWM Channel"
    default 1
config SMARTHOUSE_ACTUATOR_PWM_CH_SERVO
    int "Servo PWM Channel"
    default 2
config SMARTHOUSE_ACTUATOR_PWM_CH_IR
    int "IR PWM Channel"
    default 3

config SMARTHOUSE_ACTUATOR_PIN_SERVO
    int "SERVO_PWM pin"
    default 0
config SMARTHOUSE_ACTUATOR_PIN_BUZZER
    int "BUZZER pin"
    default 1
config SMARTHOUSE_ACTUATOR_PIN_LED
    int "LED_PWM pin"
    default 2
config SMARTHOUSE_ACTUATOR_PIN_FAN
    int "FAN_PWM pin"
    default 3
config SMARTHOUSE_ACTUATOR_PIN_MOTOR_IA
    int "MOTOR_IA pin"
    default 4
config SMARTHOUSE_ACTUATOR_PIN_MOTOR_IB
    int "MOTOR_IB pin"
    default 5
config SMARTHOUSE_ACTUATOR_PIN_RELAY
    int "RELAY_IN pin"
    default 6
config SMARTHOUSE_ACTUATOR_PIN_IR
    int "IR_PWM pin"
    default 7
config SMARTHOUSE_ACTUATOR_PIN_KEY1
    int "KEY1 pin"
    default 8
config SMARTHOUSE_ACTUATOR_PIN_KEY2
    int "KEY2 pin"
    default 9
config SMARTHOUSE_ACTUATOR_PIN_PIR
    int "PIR_IN pin"
    default 11
```

## boards_bearpi_h3863/application/samples/peripheral/smarthouse_sensor/Kconfig
```kconfig
# Smarthouse Board 2 — Sensor

config SMARTHOUSE_SENSOR_I2C_BUS
    int "I2C Bus ID"
    default 1

config SMARTHOUSE_SENSOR_I2C_SCL_PIN
    int "I2C1 SCL pin"
    default 0

config SMARTHOUSE_SENSOR_I2C_SDA_PIN
    int "I2C1 SDA pin"
    default 1

config SMARTHOUSE_SENSOR_UART_BUS
    int "UART Bus ID (PMS5003)"
    default 2

config SMARTHOUSE_SENSOR_UART_TXD_PIN
    int "PMS5003 UART TXD pin"
    default 2

config SMARTHOUSE_SENSOR_UART_RXD_PIN
    int "PMS5003 UART RXD pin"
    default 3
```

## boards_bearpi_h3863/application/samples/wifi/Kconfig
```kconfig
#===============================================================================
# @brief    Kconfig file.
# Copyright (c) @CompanyNameMagicTag 2023-2023. All rights reserved.
#===============================================================================
config SAMPLE_SUPPORT_STA_SAMPLE
    bool "Support WIFI STA Sample"

config SAMPLE_SUPPORT_SOFTAP_SAMPLE
    bool "Support WIFI SoftAP Sample."
    
config SAMPLE_SUPPORT_UDP_CLIENT_SAMPLE
    bool "Support UDP Client Sample."

config SAMPLE_SUPPORT_MQTT_SAMPLE
    bool "Support MQTT Sample (Huawei Cloud IoT)"

config SAMPLE_SUPPORT_SMARTHOUSE_GATEWAY
    bool "Support Smarthouse Gateway Board (Board 1)"
    help
        Smarthouse Board 1: WiFi+MQTT+SLE Server+health score+diagnostics.
```

## ws63_voice_center/application/samples/peripheral/smarthouse_ai/Kconfig
```kconfig
# Smarthouse Board 4 — AI Voice
config SMARTHOUSE_AI_UART_BUS
    int "CI1302 UART Bus"
    default 1

config SMARTHOUSE_AI_UART_TXD_PIN
    int "CI1302 UART TXD pin"
    default 15

config SMARTHOUSE_AI_UART_RXD_PIN
    int "CI1302 UART RXD pin"
    default 16

config SMARTHOUSE_AI_UART_BAUD
    int "CI1302 UART Baud Rate"
    default 1000000
```
